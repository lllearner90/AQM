## Software/aqm/boards/dev_board/Kconfig.dev_board
```kconfig
# Copyright (c) 2023 Espressif Systems (Shanghai) Co., Ltd.
# SPDX-License-Identifier: Apache-2.0

config BOARD_DEV_BOARD
	select SOC_ESP32_WROOM_32UE_N4
	select SOC_ESP32_PROCPU if BOARD_DEV_BOARD
	# select SOC_ESP32_APPCPU if BOARD_ESP32_DEVKITC_WROOM_ESP32_APPCPU
```

## Software/aqm/boards/dev_board/board.yml
```yaml
board:
  name: dev_board
  full_name: Development board (ESP-WROOM-32)
  vendor: espressif
  socs:
    - name: esp32
```
